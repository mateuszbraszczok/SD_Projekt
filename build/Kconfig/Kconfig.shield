## build/Kconfig/Kconfig.shield
```kconfig
osource "c:/nordic/myapps/dht/boards/shields/*/Kconfig.shield"
osource "C:/Users/Mateusz/ncs/v1.9.1/nrf/boards/shields/*/Kconfig.shield"
```

## build/Kconfig/Kconfig.shield.defconfig
```kconfig
osource "c:/nordic/myapps/dht/boards/shields/*/Kconfig.defconfig"
osource "C:/Users/Mateusz/ncs/v1.9.1/nrf/boards/shields/*/Kconfig.defconfig"
```
